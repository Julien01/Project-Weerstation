## WirelessV1.0/build/Kconfig/arch/Kconfig
```kconfig
# Load arch Kconfig descriptions.
osource "C:/Users/Julien/zephyrproject/zephyr/arch/x86/Kconfig"
osource "C:/Users/Julien/zephyrproject/zephyr/arch/xtensa/Kconfig"
osource "C:/Users/Julien/zephyrproject/zephyr/arch/sparc/Kconfig"
osource "C:/Users/Julien/zephyrproject/zephyr/arch/riscv/Kconfig"
osource "C:/Users/Julien/zephyrproject/zephyr/arch/posix/Kconfig"
osource "C:/Users/Julien/zephyrproject/zephyr/arch/nios2/Kconfig"
osource "C:/Users/Julien/zephyrproject/zephyr/arch/mips/Kconfig"
osource "C:/Users/Julien/zephyrproject/zephyr/arch/arm64/Kconfig"
osource "C:/Users/Julien/zephyrproject/zephyr/arch/arm/Kconfig"
osource "C:/Users/Julien/zephyrproject/zephyr/arch/arc/Kconfig"
```
